## drivers/input/fingerprint/Kconfig
```kconfig
config INPUT_FINGERPRINT
    tristate "Fingerprint Config Choosen"
    default y
    help
    Say Y to can config finperprint manufacturer

source "drivers/input/fingerprint/fpc/Kconfig"
source "drivers/input/fingerprint/goodix/Kconfig"
```

## drivers/smartisan/Kconfig
```kconfig
config SMARTISAN_HWINFO
	bool "smartisan hwinfo"
	---help---
	  This option enables basic support for smartisan device.
```
